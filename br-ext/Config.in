## br-ext/Config.in
```kconfig
# Top-level Config.in for PiTrezor br-ext

source "$BR2_EXTERNAL_PITREZOR_PATH/package/trezord-go/Config.in"
source "$BR2_EXTERNAL_PITREZOR_PATH/package/trezor-core/Config.in"

menu "Optional utilities"
    source "$BR2_EXTERNAL_PITREZOR_PATH/package/fbcp/Config.in"
endmenu
```

## br-ext/configs/pitrezor_rpi0_defconfig
```kconfig
# Raspberry Pi Zero (32-bit)
BR2_arm1176jzf_s=y
BR2_TOOLCHAIN_BUILDROOT_GLIBC=y
BR2_GLOBAL_PATCH_DIR="board/raspberrypi/patches"
BR2_LINUX_KERNEL_DEFCONFIG="bcmrpi_defconfig"
BR2_LINUX_KERNEL=y
BR2_LINUX_KERNEL_CUSTOM_GIT=y
BR2_LINUX_KERNEL_CUSTOM_REPO_URL="https://github.com/raspberrypi/linux.git"
BR2_LINUX_KERNEL_CUSTOM_REPO_VERSION="stable"

BR2_PACKAGE_TREZORD_GO=y
BR2_PACKAGE_LCD_SHOW=y
BR2_PACKAGE_FBCP=y
BR2_PACKAGE_PYTHON3=y
BR2_PACKAGE_PYTHON3_PIP=y
BR2_PACKAGE_PYTHON3_REQUESTS=y
BR2_PACKAGE_PYTHON3_SERIAL=y
BR2_PACKAGE_PYTHON3_SETUPTOOLS=y
```

## br-ext/configs/pitrezor_rpi3_defconfig
```kconfig
# Target
BR2_arm=y
BR2_cortex_a53=y
BR2_ARM_FPU_VFPV4D16=y
BR2_TOOLCHAIN_BUILDROOT_GLIBC=y
BR2_INIT_BUSYBOX=y
BR2_GLOBAL_PATCH_DIR=""
BR2_TARGET_GENERIC_HOSTNAME="pitrezor"
BR2_TARGET_GENERIC_ISSUE="PiTrezor (Buildroot)"
BR2_TARGET_GENERIC_REMOUNT_ROOTFS_RW=y

# Rootfs overlay
BR2_ROOTFS_OVERLAY="$(BR2_EXTERNAL_PITREZOR_PATH)/overlay"

# Disable getty/login
BR2_TARGET_GENERIC_GETTY=n

# Linux kernel (Raspberry Pi 3 / bcm2709)
BR2_LINUX_KERNEL=y
BR2_LINUX_KERNEL_USE_DEFCONFIG=y
BR2_LINUX_KERNEL_CUSTOM_TARBALL=y
BR2_LINUX_KERNEL_CUSTOM_TARBALL_LOCATION="https://github.com/raspberrypi/linux/archive/refs/tags/1.20230405.tar.gz"
BR2_LINUX_KERNEL_DEFCONFIG="bcm2709_defconfig"
BR2_LINUX_KERNEL_DTS_SUPPORT=y
BR2_LINUX_KERNEL_INTREE_DTS_NAME="bcm2710-rpi-3-b"

# Raspberry Pi firmware
BR2_PACKAGE_RPI_FIRMWARE=y
BR2_PACKAGE_RPI_FIRMWARE_VARIANT_PI3=y
BR2_PACKAGE_RPI_FIRMWARE_CONFIG_FILE="$(BR2_EXTERNAL_PITREZOR_PATH)/board/pitrezor/config.txt"
BR2_PACKAGE_RPI_FIRMWARE_CMDLINE_FILE="$(BR2_EXTERNAL_PITREZOR_PATH)/board/pitrezor/cmdline.txt"

# Common stack + hardening
BR2_PACKAGE_LIBDRM=y
BR2_PACKAGE_SDL2=y
BR2_PACKAGE_PYTHON3=y
BR2_PACKAGE_IPTABLES=y
BR2_PACKAGE_UTIL_LINUX=y
BR2_TARGET_ROOTFS_EXT2=y
BR2_TARGET_ROOTFS_TAR=y
BR2_PACKAGE_HOST_GENIMAGE=y
BR2_PACKAGE_TSLIB=y
```

## br-ext/configs/pitrezor_rpi4_64_defconfig
```kconfig
# Target (Raspberry Pi 4 / 64-bit, aarch64)
BR2_aarch64=y
BR2_TOOLCHAIN_BUILDROOT_GLIBC=y
BR2_INIT_BUSYBOX=y
BR2_GLOBAL_PATCH_DIR=""
BR2_TARGET_GENERIC_HOSTNAME="pitrezor"
BR2_TARGET_GENERIC_ISSUE="PiTrezor (Buildroot)"
BR2_TARGET_GENERIC_REMOUNT_ROOTFS_RW=y

# Rootfs overlay
BR2_ROOTFS_OVERLAY="$(BR2_EXTERNAL_PITREZOR_PATH)/overlay"

# Disable getty/login
BR2_TARGET_GENERIC_GETTY=n

# Linux kernel (Raspberry Pi 4 / bcm2711)
BR2_LINUX_KERNEL=y
BR2_LINUX_KERNEL_USE_DEFCONFIG=y
BR2_LINUX_KERNEL_DEFCONFIG="bcm2711_defconfig"
BR2_LINUX_KERNEL_DTS_SUPPORT=y
BR2_LINUX_KERNEL_INTREE_DTS_NAME="bcm2711-rpi-4-b"

# Raspberry Pi firmware + boot files
BR2_PACKAGE_RPI_FIRMWARE=y
BR2_PACKAGE_RPI_FIRMWARE_VARIANT_PI4=y
BR2_PACKAGE_RPI_FIRMWARE_CONFIG_FILE="$(BR2_EXTERNAL_PITREZOR_PATH)/board/pitrezor/config.txt"
BR2_PACKAGE_RPI_FIRMWARE_CMDLINE_FILE="$(BR2_EXTERNAL_PITREZOR_PATH)/board/pitrezor/cmdline.txt"

# Graphics stack (headless, DRM/KMS + SDL2)
BR2_PACKAGE_LIBDRM=y
BR2_PACKAGE_MESA3D=y
BR2_PACKAGE_MESA3D_GBM=y
BR2_PACKAGE_MESA3D_OPENGL_EGL=y
BR2_PACKAGE_MESA3D_OPENGL_ES=y
BR2_PACKAGE_SDL2=y
BR2_PACKAGE_SDL2_IMAGE=y
BR2_PACKAGE_SDL2_IMAGE_PNG=y

# Input / hotplug
BR2_PACKAGE_EUDEV=y

# Python for emulator launcher
BR2_PACKAGE_PYTHON3=y

# Hardening & helpers
BR2_PACKAGE_IPTABLES=y
BR2_PACKAGE_UTIL_LINUX=y
BR2_PACKAGE_UTIL_LINUX_SETPRIV=y
BR2_PACKAGE_PROCPS_NG=y

# Root filesystem (ext4)
BR2_TARGET_ROOTFS_EXT2=y
BR2_TARGET_ROOTFS_EXT2_4=y
BR2_TARGET_ROOTFS_EXT2_SIZE="256M"
BR2_TARGET_ROOTFS_EXT2_LABEL="rootfs"
BR2_TARGET_ROOTFS_TAR=y

# Image creation
BR2_PACKAGE_HOST_GENIMAGE=y
BR2_PACKAGE_HOST_DOSFSTOOLS=y
BR2_PACKAGE_HOST_MTOOLS=y
BR2_ROOTFS_POST_IMAGE_SCRIPT="$(BR2_EXTERNAL_PITREZOR_PATH)/board/pitrezor/post-image.sh"

# Users
BR2_ROOTFS_USERS_TABLES="$(BR2_EXTERNAL_PITREZOR_PATH)/board/pitrezor/users.txt"

# Touchscreen support
BR2_PACKAGE_TSLIB=y
BR2_PACKAGE_EVTEST=y
BR2_PACKAGE_FBI=y
```

## br-ext/configs/pitrezor_rpi4_defconfig
```kconfig
# Target (Raspberry Pi 4 - 32-bit kernel)
BR2_arm=y
BR2_cortex_a72=y
BR2_ARM_FPU_VFPV4D16=y
# ==========================================================
#  PiTrezor Buildroot defconfig
#  Generated: 2025-10-05 18:18 UTC
#  Notes:
#    - Uses Raspberry Pi Foundation kernel (bcm* defconfigs)
#    - Pins kernel headers to 6.1.x to match RPi LTS
#    - Consistent paths via $(BR2_EXTERNAL_PITREZOR_PATH)
#    - Enables trezord-go, lcd-show, fbcp packages
# ==========================================================

# Init & toolchain
BR2_TOOLCHAIN_BUILDROOT_GLIBC=y
BR2_INIT_BUSYBOX=y
BR2_GLOBAL_PATCH_DIR=""
BR2_TARGET_GENERIC_HOSTNAME="pitrezor"
BR2_TARGET_GENERIC_ISSUE="PiTrezor (Buildroot)"
BR2_TARGET_GENERIC_REMOUNT_ROOTFS_RW=y

# Overlay & users
BR2_ROOTFS_OVERLAY="$(BR2_EXTERNAL_PITREZOR_PATH)/overlay"
BR2_ROOTFS_USERS_TABLES="$(BR2_EXTERNAL_PITREZOR_PATH)/board/pitrezor/users.txt"
BR2_TARGET_GENERIC_GETTY=n

# Firmware / boot files
BR2_PACKAGE_RPI_FIRMWARE=y

# Graphics & input (headless UI via SDL2, no X/Wayland)
BR2_PACKAGE_LIBDRM=y
BR2_PACKAGE_SDL2=y
BR2_PACKAGE_SDL2_IMAGE=y
BR2_PACKAGE_SDL2_IMAGE_PNG=y

# Input / hotplug
BR2_PACKAGE_EUDEV=y

# Python (for launcher/helpers)
BR2_PACKAGE_PYTHON3=y

# Hardening helpers
BR2_PACKAGE_IPTABLES=y
BR2_PACKAGE_UTIL_LINUX=y
BR2_PACKAGE_PROCPS_NG=y

# Touchscreen utils
BR2_PACKAGE_TSLIB=y
BR2_PACKAGE_EVTEST=y
BR2_PACKAGE_FBI=y

# External packages (wrappers)
BR2_PACKAGE_TREZORD_GO=y
BR2_PACKAGE_LCD_SHOW=y
BR2_PACKAGE_FBCP=y

# Root filesystem (ext4), image creation
BR2_TARGET_ROOTFS_EXT2=y
BR2_TARGET_ROOTFS_EXT2_4=y
BR2_TARGET_ROOTFS_EXT2_SIZE="256M"
BR2_TARGET_ROOTFS_EXT2_LABEL="rootfs"
BR2_TARGET_ROOTFS_TAR=y
BR2_PACKAGE_HOST_GENIMAGE=y
BR2_PACKAGE_HOST_DOSFSTOOLS=y
BR2_PACKAGE_HOST_MTOOLS=y
BR2_ROOTFS_POST_IMAGE_SCRIPT="$(BR2_EXTERNAL_PITREZOR_PATH)/board/pitrezor/post-image.sh"

# Kernel headers (match RPi LTS 6.1.x)
BR2_KERNEL_HEADERS_VERSION=y
BR2_KERNEL_HEADERS_6_1=y
BR2_DEFAULT_KERNEL_VERSION="6.1.77"

# Linux kernel (RPi kernel tree)
BR2_LINUX_KERNEL=y
BR2_LINUX_KERNEL_USE_DEFCONFIG=y
BR2_LINUX_KERNEL_CUSTOM_TARBALL=y
BR2_LINUX_KERNEL_CUSTOM_TARBALL_LOCATION="https://github.com/raspberrypi/linux/archive/refs/tags/1.20230405.tar.gz"
BR2_LINUX_KERNEL_DEFCONFIG="bcm2711_defconfig"
BR2_LINUX_KERNEL_DTS_SUPPORT=y
BR2_LINUX_KERNEL_INTREE_DTS_NAME="bcm2711-rpi-4-b"

# Firmware variant
BR2_PACKAGE_RPI_FIRMWARE_VARIANT_PI4=y
BR2_PACKAGE_RPI_FIRMWARE_CONFIG_FILE="$(BR2_EXTERNAL_PITREZOR_PATH)/board/pitrezor/config.txt"
BR2_PACKAGE_RPI_FIRMWARE_CMDLINE_FILE="$(BR2_EXTERNAL_PITREZOR_PATH)/board/pitrezor/cmdline.txt"
```

## br-ext/configs/rpi0_defconfig
```kconfig
BR2_arm1176jzf_s=y
BR2_LINUX_KERNEL=y
BR2_LINUX_KERNEL_USE_DEFCONFIG=y
BR2_LINUX_KERNEL_DEFCONFIG="bcmrpi_defconfig"
BR2_LINUX_KERNEL_DTS_SUPPORT=y
BR2_LINUX_KERNEL_INTREE_DTS_NAME="bcm2835-rpi-zero"
BR2_KERNEL_HEADERS_AS_KERNEL=y
```

## br-ext/configs/rpi3_defconfig
```kconfig
BR2_arm=y
BR2_cortex_a53=y
BR2_TOOLCHAIN_BUILDROOT_MUSL=y
BR2_PACKAGE_HOST_LINUX_HEADERS_CUSTOM_6_12=y
BR2_GLOBAL_PATCH_DIR="br-ext/board/pitrezor/patches"
BR2_JLEVEL=2
BR2_ROOTFS_DEVICE_CREATION_DYNAMIC_EUDEV=y
BR2_TARGET_ENABLE_ROOT_LOGIN=n
BR2_TARGET_GENERIC_GETTY=n
BR2_TARGET_GENERIC_REMOUNT_ROOTFS_RW=n
BR2_ENABLE_LOCALE_WHITELIST="C en_US.UTF-8"
BR2_ROOTFS_USERS_TABLES="br-ext/users-table.txt"
BR2_ROOTFS_OVERLAY="br-ext/overlay"
BR2_ROOTFS_POST_IMAGE_SCRIPT="br-ext/board/pitrezor/post-image.sh"
BR2_LINUX_KERNEL=y
BR2_LINUX_KERNEL_CUSTOM_TARBALL=y
BR2_LINUX_KERNEL_CUSTOM_TARBALL_LOCATION="https://github.com/raspberrypi/linux/archive/refs/heads/rpi-6.12.y.tar.gz"
BR2_LINUX_KERNEL_DEFCONFIG="bcm2709_defconfig"
BR2_LINUX_KERNEL_DTS_SUPPORT=y
BR2_LINUX_KERNEL_DTB_IS_SELF_BUILT=y
BR2_LINUX_KERNEL_INTREE_DTS_NAME="bcm2710-rpi-3-b.dtb"
BR2_LINUX_KERNEL_DTB_KEEP_DIRNAME=y
BR2_LINUX_KERNEL_DTB_OVERLAY_SUPPORT=y
BR2_LINUX_KERNEL_INSTALL_TARGET=y
BR2_PACKAGE_RPI_FIRMWARE=y
BR2_PACKAGE_RPI_FIRMWARE_INSTALL_IMAGES=y
BR2_PACKAGE_RPI_FIRMWARE_INSTALL_DTBS=y
BR2_PACKAGE_RPI_FIRMWARE_INSTALL_DTB_OVERLAYS=y
BR2_PACKAGE_TREZORD_GO=y
BR2_PACKAGE_TREZOR_CORE=y
```

## br-ext/configs/rpi4-64_defconfig
```kconfig
BR2_aarch64=y
BR2_TOOLCHAIN_BUILDROOT_GLIBC=y
BR2_LINUX_KERNEL=y
BR2_LINUX_KERNEL_USE_DEFCONFIG=y
BR2_LINUX_KERNEL_DEFCONFIG="bcm2711_defconfig"
BR2_LINUX_KERNEL_DTS_SUPPORT=y
BR2_LINUX_KERNEL_INTREE_DTS_NAME="bcm2711-rpi-4-b"
BR2_KERNEL_HEADERS_AS_KERNEL=y
```

## br-ext/package/fbcp/Config.in
```kconfig
config BR2_PACKAGE_FBCP
    bool "fbcp"
    help
      fbcp is a framebuffer copy utility to mirror HDMI output to
      SPI TFT LCDs. Enable this if you need support for older displays.
```

## br-ext/package/lcd-show/Config.in
```kconfig
config BR2_PACKAGE_LCD_SHOW
	bool "lcd-show (Waveshare LCD helper scripts)"
	help
	  Helper scripts from Waveshare's LCD-show repo for switching
	  between display drivers on Raspberry Pi devices.
```
